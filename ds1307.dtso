/dts-v1/;
/plugin/;
/ {
	compatible = "brcm,bcm2708";
	fragment@0 {
		target = <&i2c1>;
		__overlay__ {
			#address-cells = <1>;
			#size-cells = <0>;
			status = "okay";
			ds1307: ds1307@68 {
				compatible = "dallas,ds1307";
				reg = <0x68>;
				status = "okay";
			};
		};
	};
	__overrides__ {
		ds1307 = <&ds1307>,"status";
	};
};
